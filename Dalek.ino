// C++ code
//
#include <PCM.h>

const unsigned char sample[] PROGMEM = { 
  126, 127, 127, 127, 127, 127, 127, 127, 127, 128, 128, 129,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 127,  
};

const int leftSensor = A2;     // input from left sensor
const int rightSensor = A1;    // input from right sensor
const int turnRight = 7;       // output to H-bridge to turn right
const int turnLeft = 8;        // output to H-bridge to turn right
const int whiteLED = 2;        // output to white LED
const int redLED = 4;          // output to red LED
const int rickOutput = 13;


void setup()
{
// set up serial monitor
  Serial.begin(9600);
  
// set INPUT pins
  pinMode(leftSensor, INPUT);
  pinMode(rightSensor, INPUT);
  
// set OUTPUT pins
  pinMode(turnRight, OUTPUT);
  pinMode(turnLeft, OUTPUT);
  pinMode(whiteLED, OUTPUT);
  pinMode(redLED, OUTPUT);
  pinMode(rickOutput, OUTPUT);
}

void loop()
{

  bool leftOn = false;
  bool rightOn = false;
  // turn rick on
  digitalWrite(rickOutput, LOW);

  // assign low voltage input (no signal)
  float lowVoltageThreshold = 1;
  
// assign high voltage, minimum for extermiante
  float highVoltageThreshold = 3.5;
  
// read each analog pin 
  float leftReading = analogRead(leftSensor);
  float rightReading = analogRead(rightSensor);
  
// determine left and right input for analysis
  float leftInput = (leftReading/1023) * 5.0;
  float rightInput = (rightReading/1023) * 5.0;
  
// determin the difference between each input, and assign
// a low difference
//   float readingDifference = leftInput - rightInput;
//   float lowReadingDifference = 0.3;

// Determine if the left sensor is on
  if (leftInput >= highVoltageThreshold) {
    leftOn = true;
  }
  if (rightInput >= highVoltageThreshold) {
    rightOn = true;
  }
  
// array of on and off times for the exterminate LEDs whilst 
// the speaker is playing

 
  //int timeOn[17] = {200, 200, 66.7, 200, 133.4, 133.4, 66.7, 200, 133.4, 133.4, 133.4, 200, 50, 50, 50, 50, 50};
  //int timeOff[17] = {100, 100, 33.3, 100, 66.6, 66.6, 33.3, 100, 66.6, 66.6, 66.6, 1000, 50, 50, 50, 50, 50};

  int timeOn[17] = {150, 150, 50, 150, 100, 100, 50, 150, 100, 100, 100, 150, 50, 50, 50, 50, 50};
  int timeOff[17] = {150, 150, 50, 150, 100, 100, 50, 150, 100, 100, 100, 1000, 50, 50, 50, 50, 50};
  
// if both the left and right inputs indicate a low signal, then the
// Dalek completes a large turn/pulse
  if (leftInput < lowVoltageThreshold && rightInput < lowVoltageThreshold) {
    digitalWrite(turnRight, HIGH);
    digitalWrite(turnLeft, LOW);
    delay(1000);
    digitalWrite(turnRight, LOW);
    delay(500); // delay gives the Dalek a chance to stop and readjust
        
  } 
  
// if the difference between outputs is small enough and each input is 
// large enough, then the Dalek stops moving and begins its extermination sequence
  //else if (abs(readingDifference) < lowReadingDifference && (leftInput >= highVoltageThreshold && rightInput >= highVoltageThreshold))
  else if (leftOn && rightOn)
  {
    // Dalek stops moving
    digitalWrite(turnRight, LOW);
    digitalWrite(turnLeft, LOW);
    digitalWrite(rickOutput, HIGH);

    //Begin speaker audio
    startPlayback(sample, sizeof(sample));
    
    // Begin LED sequence
    for (int t=0; t < 17; t+=1) {
      digitalWrite(whiteLED, HIGH);
      digitalWrite(redLED, HIGH);
      delay(timeOn[t]);
      digitalWrite(whiteLED, LOW);
      digitalWrite(redLED, LOW);
      delay(timeOff[t]);    
    }
  } 
// if the right input is larger than the left input, then
// rotate the Dalek right
  else if (rightOn) {
    digitalWrite(turnRight, HIGH);
    digitalWrite(turnLeft, LOW);
    delay(500);
    digitalWrite(turnRight, LOW);
    delay(400);    
  } 
// if the left input is larger than the right input, then
// rotate the Dalek left
  else {
    digitalWrite(turnRight, LOW);
    digitalWrite(turnLeft, HIGH);
    delay(500);
    digitalWrite(turnLeft, LOW);
    delay(400);
    
  } 
}
